    /////////////////////////////////////////////////////////////////
   //      Arduino OLED Display Graphics Tutorial v1.00           //
  //       Get the latest version of the code here:              //
 //   http://educ8s.tv/arduino-oled-display-graphics-tutorial   //
/////////////////////////////////////////////////////////////////

#include "U8glib.h"

U8GLIB_SH1106_128X64 u8g(U8G_I2C_OPT_NO_ACK);	// Display which does not send ACK

int frame = 0;


const unsigned char GreenBreezelogoBitMap[] PROGMEM= {
0x00, 0x00, 0x00, 0x00, 0x00, 0x00, 0x00, 0x00, 0x00, 0x00, 0x00, 0x00, 0x00, 0x00, 0x00, 0x00,
0x00, 0x00, 0x00, 0x00, 0x00, 0x00, 0x00, 0x0F, 0xF0, 0x00, 0x00, 0x00, 0x00, 0x00, 0x00, 0x00,
0x00, 0x00, 0x00, 0x00, 0x00, 0x00, 0x00, 0x1F, 0xF8, 0x00, 0x00, 0x00, 0x00, 0x00, 0x00, 0x00,
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0x00, 0x00, 0x00, 0x00, 0x00, 0x01, 0x00, 0x3F, 0xFC, 0x00, 0x00, 0x00, 0x00, 0x00, 0x00, 0x00
};

void drawGB()
{
  if(frame==0)
   u8g.drawBitmapP( 0, 0, 16, 64, GreenBreezelogoBitMap);
  else if (frame == 1)
   u8g.drawBitmapP( 0, 0, 16, 64, GreenBreezelogoBitMap);
  else if(frame == 2)
   u8g.drawBitmapP( 0, 0, 16, 64, GreenBreezelogoBitMap);
   else if(frame == 3)
   u8g.drawBitmapP( 0, 0, 16, 64, GreenBreezelogoBitMap);
}

int VoltagePin = 0, CurrentPin = 1, LightPin = 2; 
float Voltage = 0, Current = 0, Power = 0, Light = 0;

void setup(void) {

Voltage = analogRead(VoltagePin) / 40.92;
Current = (((analogRead(CurrentPin) * 5.0) / 1023.0) - 2.5) / 0.066;
Power = Voltage*Current;

}

void loop(void) {

Serial.begin(9600);
  
Serial.println("Voltage");
Serial.println(Voltage);
Serial.println("");
Serial.println("Current");
Serial.println(Current);
Serial.println("");
Serial.println("Power");
Serial.println(Power);
Serial.println("");
Voltage = 0;
Current = 0;
Power = 0;


delay(2000);




 u8g.firstPage();
  do{
   drawGB();
 } while(u8g.nextPage());
 
 frame ++;
 if(frame>3)
 frame = 0;
delay(3000);
}
